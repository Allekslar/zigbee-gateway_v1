## main/Kconfig.projbuild
```kconfig
# SPDX-License-Identifier: AGPL-3.0-only
# Copyright (C) 2026 Alex.K.

menu "Zigbee Gateway"

config ZGW_ENABLE_DEBUG_LOGS
    bool "Enable debug logs"
    default y

config ZGW_ZIGBEE_ENABLED
    bool "Enable Zigbee radio/coexistence startup"
    default y
    help
        Keep this enabled for the normal gateway profile. Disable only for an
        explicit development/RF-isolation build profile (for example, an OTA
        HIL isolation test) that intentionally must not start the deferred
        Zigbee task. Production builds must not ship with this disabled.

menu "OTA"

config ZGW_OTA_ENABLED
    bool "Enable OTA foundation"
    default y

config ZGW_OTA_BOOT_CONFIRM_ENABLED
    bool "Confirm pending OTA image after successful startup"
    depends on ZGW_OTA_ENABLED
    default y

config ZGW_OTA_BOOT_CONFIRM_TIMEOUT_MS
    int "OTA boot confirmation timeout in milliseconds"
    depends on ZGW_OTA_BOOT_CONFIRM_ENABLED
    range 1000 120000
    default 15000

choice ZGW_OTA_TLS_TRUST_MODE
    prompt "OTA HTTPS trust mode"
    depends on ZGW_OTA_ENABLED
    default ZGW_OTA_TLS_TRUST_CERT_BUNDLE

config ZGW_OTA_TLS_TRUST_CERT_BUNDLE
    bool "Use ESP x509 certificate bundle"

config ZGW_OTA_TLS_TRUST_PINNED_CA
    bool "Use pinned root CA PEM embedded in firmware"

endchoice

config ZGW_OTA_ALLOW_HTTP_URLS_FOR_TESTING
    bool "Allow plaintext http:// OTA URLs for lab/testing only"
    depends on ZGW_OTA_ENABLED
    default n
    help
        Keep disabled for production. When enabled, OTA can download over
        plaintext HTTP, which bypasses TLS trust checks and should be used
        only for controlled lab/HIL scenarios.

config ZGW_OTA_AUTO_REBOOT_ENABLED
    bool "Automatically reboot after successful OTA staging"
    depends on ZGW_OTA_ENABLED
    default y

config ZGW_OTA_REBOOT_DELAY_MS
    int "Delay before OTA-triggered reboot in milliseconds"
    depends on ZGW_OTA_AUTO_REBOOT_ENABLED
    range 500 30000
    default 3000

endmenu

menu "RCP Update"

comment "Current ESP32-C6-DevKitC builds use the native 802.15.4 radio; external RCP backends are future optional hardware support"

choice ZGW_RCP_TARGET_BACKEND
    prompt "RCP target backend"
    default ZGW_RCP_TARGET_BACKEND_NONE
    help
        Keep this set to "No target backend" for the current ESP32-C6-DevKitC
        board. Enable an external RCP backend only for a different hardware
        target that actually contains a separate radio co-processor and the
        required UART/BOOT/RESET wiring.

config ZGW_RCP_TARGET_BACKEND_NONE
    bool "No target backend"
    help
        Default and correct option for the current ESP32-C6-DevKitC target.
        Zigbee runs on the native ESP32-C6 802.15.4 radio, so there is no
        external RCP to flash or recover.

config ZGW_RCP_TARGET_BACKEND_UART
    bool "UART maintenance backend"
    help
        Optional groundwork for a future board with a separate external RCP.
        This is not part of the active production path for the current
        ESP32-C6-DevKitC target.

endchoice

config ZGW_RCP_UART_PORT
    int "RCP UART port number"
    depends on ZGW_RCP_TARGET_BACKEND_UART
    default 1
    help
        UART port used only by an external RCP maintenance path on future
        hardware. Not used on the current ESP32-C6-DevKitC board.

config ZGW_RCP_UART_TX_GPIO
    int "RCP UART TX GPIO"
    depends on ZGW_RCP_TARGET_BACKEND_UART
    default -1

config ZGW_RCP_UART_RX_GPIO
    int "RCP UART RX GPIO"
    depends on ZGW_RCP_TARGET_BACKEND_UART
    default -1

config ZGW_RCP_UART_BAUDRATE
    int "RCP UART baudrate"
    depends on ZGW_RCP_TARGET_BACKEND_UART
    range 9600 5000000
    default 460800

config ZGW_RCP_UART_BOOT_GPIO
    int "RCP BOOT mode GPIO (-1 to disable)"
    depends on ZGW_RCP_TARGET_BACKEND_UART
    default -1

config ZGW_RCP_UART_RESET_GPIO
    int "RCP RESET GPIO (-1 to disable)"
    depends on ZGW_RCP_TARGET_BACKEND_UART
    default -1

config ZGW_RCP_UART_BOOT_ACTIVE_HIGH
    bool "BOOT GPIO active high"
    depends on ZGW_RCP_TARGET_BACKEND_UART
    default n

config ZGW_RCP_UART_RESET_ACTIVE_HIGH
    bool "RESET GPIO active high"
    depends on ZGW_RCP_TARGET_BACKEND_UART
    default n

config ZGW_RCP_UART_ENTER_UPDATE_DELAY_MS
    int "Delay after entering update mode (ms)"
    depends on ZGW_RCP_TARGET_BACKEND_UART
    range 0 1000
    default 50

config ZGW_RCP_UART_RESET_PULSE_MS
    int "Reset pulse width (ms)"
    depends on ZGW_RCP_TARGET_BACKEND_UART
    range 1 1000
    default 20

endmenu

config ZGW_MQTT_TRANSPORT_ENABLED
    bool "Enable MQTT transport adapter"
    default n

config ZGW_MQTT_BROKER_URI
    string "MQTT broker URI"
    depends on ZGW_MQTT_TRANSPORT_ENABLED
    default "mqtt://homeassistant.local:1883"

config ZGW_MQTT_CLIENT_ID
    string "MQTT client id"
    depends on ZGW_MQTT_TRANSPORT_ENABLED
    default "zigbee-gateway"

config ZGW_MQTT_USERNAME
    string "MQTT username"
    depends on ZGW_MQTT_TRANSPORT_ENABLED
    default ""

config ZGW_MQTT_PASSWORD
    string "MQTT password"
    depends on ZGW_MQTT_TRANSPORT_ENABLED
    default ""

config ZGW_MQTT_KEEPALIVE_SEC
    int "MQTT keepalive seconds"
    depends on ZGW_MQTT_TRANSPORT_ENABLED
    range 15 300
    default 120

config ZGW_MQTT_NETWORK_TIMEOUT_MS
    int "MQTT network timeout (ms)"
    depends on ZGW_MQTT_TRANSPORT_ENABLED
    range 1000 60000
    default 30000

config ZGW_MQTT_RECONNECT_TIMEOUT_MS
    int "MQTT reconnect backoff (ms)"
    depends on ZGW_MQTT_TRANSPORT_ENABLED
    range 1000 120000
    default 45000

config ZGW_MQTT_RESUME_AFTER_OTA_DELAY_MS
    int "MQTT resume delay after OTA failure (ms)"
    depends on ZGW_MQTT_TRANSPORT_ENABLED
    range 0 30000
    default 2000

menu "Security"

comment "S6 required change: 'Before implementing the control-plane changes, create the Kconfig definitions and one typed security-bounds accessor.' Two related settings are deliberately NOT configurable here: the provisioning passphrase length (fixed 16 Base32 characters) and login backoff (fixed 2s start / 60s max) -- see components/service/include/security_bounds.hpp."

config ZGW_PRODUCTION_PROFILE
    bool "Production security profile active"
    default n
    help
        Set to y only via sdkconfig.production.esp32c6 (layered in when
        ZGW_PRODUCTION_BUILD is set at build time -- see
        docs/security/PRODUCTION_HARDENING.md Section 2.2). Distinguishes
        the production ProvisioningSecretProvider adapter (reads real
        manufacturing proof-of-possession material, fails closed if
        absent) from the development adapter (may generate and print a
        one-time secret) -- plan S6 "Provisioning and credentials" #2.
        Never set this directly in sdkconfig.defaults*; it must stay
        development-profile default everywhere except the production
        layering path.

config ZGW_COMMISSIONING_WINDOW_SECONDS
    int "Commissioning window duration (seconds)"
    range 60 600
    default 600
    help
        How long first-boot/physical-presence-triggered commissioning mode
        stays open before it must be re-triggered. FD-13 hard range.

config ZGW_JSON_MAX_BODY_BYTES
    int "Strict JSON reader: maximum request body size (bytes)"
    range 512 2048
    default 2048

config ZGW_JSON_MAX_DEPTH
    int "Strict JSON reader: maximum nesting depth"
    range 2 4
    default 4

config ZGW_JSON_MAX_STRING_BYTES
    int "Strict JSON reader: maximum string value length (bytes)"
    range 64 512
    default 512

config ZGW_JSON_MAX_KEYS
    int "Strict JSON reader: maximum object keys"
    range 8 32
    default 32

config ZGW_LOGIN_ATTEMPTS_PER_MINUTE
    int "Login rate limit (attempts per minute per source)"
    range 1 5
    default 5

config ZGW_COMMANDS_PER_MINUTE
    int "Ordinary command rate limit (per minute per session)"
    range 10 60
    default 60

config ZGW_MUTATIONS_PER_MINUTE
    int "Join/remove/network-mutation rate limit (per minute per session)"
    range 1 5
    default 5

config ZGW_FIRMWARE_OPS_PER_HOUR
    int "OTA/RCP operation rate limit (per hour per session)"
    range 1 2
    default 2

config ZGW_AUDIT_RING_RECORDS
    int "Security audit ring capacity (records)"
    range 32 128
    default 128

config ZGW_PHYSICAL_PRESENCE_BUTTON_GPIO
    int "Physical-presence trusted button GPIO"
    range 0 30
    default 9
    help
        GPIO reporting the trusted physical-presence button state (plan
        S6 "Authorization and physical presence" #21). Default 9 matches
        the BOOT button on the ESP32-C6-DevKitC-1 reference board this
        project targets -- confirmed via Espressif's own official
        documentation: GPIO9 is a strapping pin only during power-up/
        reset, safely readable as an ordinary active-low input
        afterward (see components/app_hal/hal_button.c).

endmenu

endmenu
```
