## sdkconfig.defaults
```kconfig
CONFIG_ZGW_MQTT_TRANSPORT_ENABLED=y
CONFIG_ZGW_MQTT_BROKER_URI="mqtt://homeassistant.local:1883"
CONFIG_ZGW_MQTT_CLIENT_ID="zigbee-gateway"
CONFIG_ZGW_MQTT_KEEPALIVE_SEC=120
```

## sdkconfig.defaults.esp32c6
```kconfig
CONFIG_ZB_ENABLED=y
CONFIG_ZB_ZCZR=y
CONFIG_ZB_RADIO_NATIVE=y
# CONFIG_ZB_GP_ENABLED is not set
CONFIG_ESPTOOLPY_FLASHSIZE_8MB=y
CONFIG_BOOTLOADER_APP_ROLLBACK_ENABLE=y
CONFIG_LWIP_MAX_SOCKETS=16
CONFIG_MBEDTLS_CERTIFICATE_BUNDLE=y
CONFIG_MBEDTLS_ASYMMETRIC_CONTENT_LEN=y
CONFIG_MBEDTLS_SSL_IN_CONTENT_LEN=8192
CONFIG_MBEDTLS_SSL_OUT_CONTENT_LEN=2048
CONFIG_MBEDTLS_DYNAMIC_BUFFER=y
CONFIG_MBEDTLS_SSL_VARIABLE_BUFFER_LENGTH=y
# CONFIG_MBEDTLS_SSL_KEEP_PEER_CERTIFICATE is not set
CONFIG_ZGW_MQTT_NETWORK_TIMEOUT_MS=30000
CONFIG_ZGW_MQTT_RECONNECT_TIMEOUT_MS=45000
CONFIG_ZGW_MQTT_RESUME_AFTER_OTA_DELAY_MS=2000
CONFIG_ZGW_OTA_TLS_TRUST_CERT_BUNDLE=y
# CONFIG_ZGW_OTA_TLS_TRUST_PINNED_CA is not set
# CONFIG_ZGW_OTA_ALLOW_HTTP_URLS_FOR_TESTING is not set
CONFIG_PARTITION_TABLE_CUSTOM=y
CONFIG_PARTITION_TABLE_CUSTOM_FILENAME="partitions.csv"
CONFIG_PARTITION_TABLE_FILENAME="partitions.csv"
```

## test/target/sdkconfig.defaults
```kconfig
# Partition table for target tests: use project custom layout with Zigbee NVRAM partitions.
# CONFIG_PARTITION_TABLE_SINGLE_APP is not set
# CONFIG_PARTITION_TABLE_SINGLE_APP_LARGE is not set
CONFIG_PARTITION_TABLE_CUSTOM=y
CONFIG_PARTITION_TABLE_FILENAME="partitions.csv"

# Target board uses 8MB flash; keep image header and flashing config aligned.
CONFIG_ESPTOOLPY_FLASHSIZE_8MB=y
CONFIG_ESPTOOLPY_FLASHSIZE="8MB"
CONFIG_ESPTOOLPY_HEADER_FLASHSIZE_UPDATE=y
# Target test suite exercises HTTP + runtime paths in app_main context.
# Increase main task stack to avoid stack-protection resets in Unity runs.
CONFIG_ESP_MAIN_TASK_STACK_SIZE=8192

# Enable native Zigbee stack in target-test firmware so HAL Zigbee tests run on real path.
CONFIG_ZB_ENABLED=y
CONFIG_ZB_ZCZR=y
CONFIG_ZB_RADIO_NATIVE=y
```
